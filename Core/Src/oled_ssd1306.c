#include <string.h>

#include "i2c.h"
#include "oled_ssd1306.h"

#define OLED_I2C_ADDRESS       (0x3CU << 1)
#define OLED_CMD_CONTROL       0x00U
#define OLED_DATA_CONTROL      0x40U
#define OLED_BUFFER_SIZE       (OLED_WIDTH * OLED_HEIGHT / 8U)
#define OLED_CHAR_WIDTH        6U
#define OLED_CHAR_HEIGHT       8U
#define OLED_I2C_TIMEOUT_MS    10U

static uint8_t s_oledBuffer[OLED_BUFFER_SIZE];
static uint8_t s_oledReady = 0U;

static const uint8_t s_font5x7[][5] = {
    {0x00,0x00,0x00,0x00,0x00}, {0x00,0x00,0x5F,0x00,0x00}, {0x00,0x07,0x00,0x07,0x00},
    {0x14,0x7F,0x14,0x7F,0x14}, {0x24,0x2A,0x7F,0x2A,0x12}, {0x23,0x13,0x08,0x64,0x62},
    {0x36,0x49,0x55,0x22,0x50}, {0x00,0x05,0x03,0x00,0x00}, {0x00,0x1C,0x22,0x41,0x00},
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    {0x00,0x41,0x36,0x08,0x00}, {0x10,0x08,0x08,0x10,0x08}, {0x00,0x06,0x09,0x09,0x06}
};

static HAL_StatusTypeDef oled_write_command(uint8_t command)
{
  uint8_t packet[2] = {OLED_CMD_CONTROL, command};
  return HAL_I2C_Master_Transmit(&hi2c1, OLED_I2C_ADDRESS, packet, sizeof(packet), OLED_I2C_TIMEOUT_MS);
}

static HAL_StatusTypeDef oled_write_data_chunk(const uint8_t *data, uint16_t length)
{
  uint8_t packet[17];

  if ((data == NULL) || (length == 0U) || (length > 16U)) {
    return HAL_ERROR;
  }

  packet[0] = OLED_DATA_CONTROL;
  (void)memcpy(&packet[1], data, length);
  return HAL_I2C_Master_Transmit(&hi2c1,
                                 OLED_I2C_ADDRESS,
                                 packet,
                                 (uint16_t)(length + 1U),
                                 OLED_I2C_TIMEOUT_MS);
}

uint8_t OLED_Init(void)
{
  static const uint8_t init_commands[] = {
      0xAE, 0x20, 0x00, 0xB0, 0xC8, 0x00, 0x10, 0x40,
      0x81, 0x7F, 0xA1, 0xA6, 0xA8, 0x3F, 0xA4, 0xD3,
      0x00, 0xD5, 0x80, 0xD9, 0xF1, 0xDA, 0x12, 0xDB,
      0x40, 0x8D, 0x14, 0xAF
  };
  uint16_t idx;

  if (HAL_I2C_IsDeviceReady(&hi2c1, OLED_I2C_ADDRESS, 2U, OLED_I2C_TIMEOUT_MS) != HAL_OK) {
    s_oledReady = 0U;
    return 0U;
  }

  for (idx = 0U; idx < (uint16_t)sizeof(init_commands); ++idx) {
    if (oled_write_command(init_commands[idx]) != HAL_OK) {
      s_oledReady = 0U;
      return 0U;
    }
  }

  s_oledReady = 1U;
  OLED_Clear();
  OLED_Update();
  return 1U;
}

uint8_t OLED_IsReady(void)
{
  return s_oledReady;
}

void OLED_Clear(void)
{
  (void)memset(s_oledBuffer, 0, sizeof(s_oledBuffer));
}

static void oled_draw_char(uint8_t x, uint8_t y, char c)
{
  uint8_t col;
  uint8_t page;
  uint16_t buffer_index;
  const uint8_t *glyph;

  if ((x >= OLED_WIDTH) || (y >= OLED_HEIGHT)) {
    return;
  }

  if ((uint8_t)c < 32U || (uint8_t)c > 127U) {
    c = '?';
  }

  page = (uint8_t)(y / OLED_CHAR_HEIGHT);
  if (page >= (OLED_HEIGHT / 8U)) {
    return;
  }

  glyph = s_font5x7[(uint8_t)c - 32U];
  buffer_index = (uint16_t)page * OLED_WIDTH + x;

  for (col = 0U; col < 5U; ++col) {
    if ((x + col) < OLED_WIDTH) {
      s_oledBuffer[buffer_index + col] = glyph[col];
    }
  }

  if ((x + 5U) < OLED_WIDTH) {
    s_oledBuffer[buffer_index + 5U] = 0x00U;
  }
}

void OLED_DrawString(uint8_t x, uint8_t y, const char *text)
{
  uint8_t cursor_x = x;

  if (text == NULL) {
    return;
  }

  while ((*text != '\0') && (cursor_x + OLED_CHAR_WIDTH <= OLED_WIDTH)) {
    oled_draw_char(cursor_x, y, *text);
    cursor_x = (uint8_t)(cursor_x + OLED_CHAR_WIDTH);
    text++;
  }
}

void OLED_Update(void)
{
  uint8_t page;

  if (s_oledReady == 0U) {
    return;
  }

  for (page = 0U; page < 8U; ++page) {
    uint16_t offset = (uint16_t)page * OLED_WIDTH;
    uint8_t chunk;

    if ((oled_write_command((uint8_t)(0xB0U + page)) != HAL_OK) ||
        (oled_write_command(0x00U) != HAL_OK) ||
        (oled_write_command(0x10U) != HAL_OK)) {
      s_oledReady = 0U;
      return;
    }

    for (chunk = 0U; chunk < (OLED_WIDTH / 16U); ++chunk) {
      if (oled_write_data_chunk(&s_oledBuffer[offset + ((uint16_t)chunk * 16U)], 16U) != HAL_OK) {
        s_oledReady = 0U;
        return;
      }
    }
  }
}
